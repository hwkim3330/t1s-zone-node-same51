## CMakeLists.txt
```
# SPDX-License-Identifier: Apache-2.0
cmake_minimum_required(VERSION 3.20.0)

# Out-of-tree board (boards/microchip/same51_cnano)
list(APPEND BOARD_ROOT ${CMAKE_CURRENT_LIST_DIR}/../..)

# In a sysbuild (MCUboot) an option for this image is given as -D<image>_<VAR> (here node_T1S_SLOT,
# node_LAMP_SLOT) and reaches the image only through the sysbuild cache file; zephyr_get() would read it,
# but it exists only after find_package(Zephyr), and the overlays must be chosen before that.
function(sysbuild_option var)
  if(DEFINED SYSBUILD_CACHE AND EXISTS "${SYSBUILD_CACHE}")
    file(STRINGS "${SYSBUILD_CACHE}" lines)
    set(name "")
    foreach(l IN LISTS lines)
      if(l MATCHES "^SYSBUILD_NAME:[^=]*=(.*)$")
        set(name "${CMAKE_MATCH_1}")
      endif()
    endforeach()
    foreach(l IN LISTS lines)
      if(name AND l MATCHES "^${name}_${var}:[^=]*=(.*)$")
        set(${var} "${CMAKE_MATCH_1}" CACHE STRING "" FORCE)
      endif()
    endforeach()
  endif()
endfunction()
sysbuild_option(T1S_SLOT)
sysbuild_option(LAMP_SLOT)
sysbuild_option(PANEL_SLOT)
sysbuild_option(SENSOR_SLOT)
sysbuild_option(BUS_KEY_FILE)

# The bus shell's HMAC key (Kconfig APP_BUS_SHELL_AUTH): a build-time secret, never in the repository.
# -Dnode_BUS_KEY_FILE= (sysbuild) / -DBUS_KEY_FILE=, else $T1S_BUS_KEY_FILE, else ~/.config/t1s-keys/bus.key.
if(NOT BUS_KEY_FILE)
  if(DEFINED ENV{T1S_BUS_KEY_FILE})
    set(BUS_KEY_FILE $ENV{T1S_BUS_KEY_FILE})
  else()
    set(BUS_KEY_FILE $ENV{HOME}/.config/t1s-keys/bus.key)
  endif()
endif()

# Which mikroBUS slot holds the Two-Wire ETH click (found by apps/probe).
set(T1S_SLOT 1 CACHE STRING "mikroBUS slot (1-3) of the MIKROE-5543 click")
list(APPEND EXTRA_DTC_OVERLAY_FILE
     ${CMAKE_CURRENT_LIST_DIR}/../../dts/two-wire-eth-click-slot${T1S_SLOT}.overlay)

# zenoh-pico 1.10.1 as a Zephyr module. In a workspace made from this repo's west.yml it is a west project
# (modules/lib/zenoh-pico) and Zephyr finds it by itself. Otherwise (the bench PC's older ~/zephyrproject,
# whose manifest is Zephyr's own) it is added from ZENOH_PICO_DIR: -DZENOH_PICO_DIR=... or the tree the ESP
# T1S HAT firmware vendors. Both are 1.10.1 + zenoh-pico-patches/.
if(NOT ZEPHYR_BASE AND DEFINED ENV{ZEPHYR_BASE})
  set(_zbase $ENV{ZEPHYR_BASE})
else()
  set(_zbase ${ZEPHYR_BASE})
endif()
if(EXISTS ${_zbase}/../modules/lib/zenoh-pico/zephyr/module.yml AND NOT ZENOH_PICO_DIR)
  message(STATUS "zenoh-pico: west project ${_zbase}/../modules/lib/zenoh-pico")
else()
  set(ZENOH_PICO_DIR $ENV{HOME}/esp32-t1s-bridge/vendor/zenoh-pico CACHE PATH "zenoh-pico source")
  if(NOT EXISTS ${ZENOH_PICO_DIR}/zephyr/module.yml)
    message(FATAL_ERROR "zenoh-pico not found: build in a workspace made from west.yml (README), or -DZENOH_PICO_DIR=")
  endif()
  list(APPEND ZEPHYR_EXTRA_MODULES ${ZENOH_PICO_DIR})
endif()

# Zone lamp outputs (left/right/brake/reverse) on a free mikroBUS slot; 0 = none
set(LAMP_SLOT 0 CACHE STRING "mikroBUS slot for plain GPIO lamp outputs (0 = none; the 10x10 panel shows the lamps)")
set(PANEL_SLOT 2 CACHE STRING "mikroBUS slot of the 10x10 RGB click (0 = none)")
set(SENSOR_SLOT 3 CACHE STRING "mikroBUS slot of the thumbstick / proximity click (0 = none)")
foreach(s PANEL_SLOT SENSOR_SLOT)
  if(NOT ${s} STREQUAL "0")
    if(${s} STREQUAL T1S_SLOT)
      message(FATAL_ERROR "${s} ${${s}} is the T1S click's slot")
    endif()
  endif()
endforeach()
if(NOT PANEL_SLOT STREQUAL "0")
  list(APPEND EXTRA_DTC_OVERLAY_FILE ${CMAKE_CURRENT_LIST_DIR}/../../dts/panel-slot${PANEL_SLOT}.overlay)
  if(PANEL_SLOT STREQUAL "2")
    # WS2812 data through SERCOM0 + DMA (the overlay's panel-spi); slot 2's PA11 is SERCOM0 PAD3
    list(APPEND EXTRA_CONF_FILE ${CMAKE_CURRENT_LIST_DIR}/panel-spi.conf)
  endif()
endif()
if(NOT SENSOR_SLOT STREQUAL "0")
  list(APPEND EXTRA_DTC_OVERLAY_FILE ${CMAKE_CURRENT_LIST_DIR}/../../dts/sensors-slot${SENSOR_SLOT}.overlay)
endif()
if(LAMP_SLOT STREQUAL T1S_SLOT)
  message(FATAL_ERROR "LAMP_SLOT ${LAMP_SLOT} is the T1S click's slot: pick another (README: Slot plan)")
endif()
if(NOT LAMP_SLOT STREQUAL "0")
  list(APPEND EXTRA_DTC_OVERLAY_FILE
       ${CMAKE_CURRENT_LIST_DIR}/../../dts/zone-lamps-slot${LAMP_SLOT}.overlay)
endif()

find_package(Zephyr REQUIRED HINTS $ENV{ZEPHYR_BASE})
project(t1s_zone_node)

target_sources(app PRIVATE src/main.c src/t1s_diag.c src/ptp.c)
# LAN8651 frame timestamps: needs the LOCAL PATCH in zephyr-patches/ applied to the zephyr tree
zephyr_compile_definitions(LAN865X_FRAME_TIMESTAMPS)
if(CONFIG_APP_ZENOH)
  # the module does not run zenoh-pico's configure step; this is its config.h
  zephyr_include_directories(${CMAKE_CURRENT_LIST_DIR}/zenoh-config)
  zephyr_compile_definitions(ZENOH_LOG_WARN)
  target_sources(app PRIVATE src/zone_zenoh.c src/zone_lamps.c src/zone_panel.c)
endif()
if(CONFIG_APP_BUS_SHELL_AUTH)
  # -> <build>/bus_key/bus_key.h (the build directory is not committed). Missing key = every command refused.
  set(_kdir ${CMAKE_CURRENT_BINARY_DIR}/bus_key)
  if(EXISTS ${BUS_KEY_FILE})
    file(READ ${BUS_KEY_FILE} _k)
    string(STRIP "${_k}" _k)
    string(LENGTH "${_k}" _kl)
    if(NOT _k MATCHES "^[0-9a-fA-F]+$" OR NOT _kl EQUAL 64)
      message(FATAL_ERROR "${BUS_KEY_FILE}: expected 64 hex digits (32 bytes)")
    endif()
    string(TOLOWER "${_k}" _k)
    string(SHA256 _kid "${_k}")
    string(SUBSTRING "${_kid}" 0 8 _kid)
    string(REGEX REPLACE "([0-9a-f][0-9a-f])" "0x\\1," _kb "${_k}")
    set(_hdr "/* generated from ${BUS_KEY_FILE} -- secret, do not commit */\n#define BUS_KEY_ID \"${_kid}\"\nstatic const uint8_t bus_key[32] = {${_kb}};\n")
    message(STATUS "bus shell key: ${BUS_KEY_FILE} (id ${_kid})")
    set_property(DIRECTORY APPEND PROPERTY CMAKE_CONFIGURE_DEPENDS ${BUS_KEY_FILE})
  else()
    message(WARNING "no bus shell key (${BUS_KEY_FILE}): this image refuses every bus shell command")
    set(_hdr "#define BUS_KEY_MISSING 1\n#define BUS_KEY_ID \"none\"\nstatic const uint8_t bus_key[32];\n")
  endif()
  file(CONFIGURE OUTPUT ${_kdir}/bus_key.h CONTENT "${_hdr}")
  target_include_directories(app PRIVATE ${_kdir})
endif()
if(CONFIG_APP_SMP_FILTER OR CONFIG_APP_IRQ_PROBE)
  target_sources(app PRIVATE src/zone_guard.c)
endif()
if(CONFIG_PTP)
  # ptp.c moves the experimental IEEE 1588 stack (ptp1588.conf) to domain 77 through its private header
  target_include_directories(app PRIVATE ${ZEPHYR_BASE})
endif()
# t1s_diag.c reads PLCA status through the in-tree driver's OA TC6 helpers
target_include_directories(app PRIVATE
  ${ZEPHYR_BASE}/drivers/ethernet
  ${ZEPHYR_BASE}/subsys/net/l2)
```

## Kconfig
```
# SPDX-License-Identifier: Apache-2.0
mainmenu "T1S zone node"

config APP_PLCA_NODE_ID
	int "PLCA node id (0 = coordinator)"
	range 0 254
	default 1

config APP_PLCA_NODE_COUNT
	int "PLCA node count (used only by the coordinator)"
	range 1 255
	default 8

config APP_PLCA_TO_TIMER
	int "PLCA TO timer (bit times)"
	default 32

config APP_PLCA_BURST_COUNT
	int "PLCA max burst count"
	default 0

config APP_PLCA_BURST_TIMER
	int "PLCA burst timer"
	default 128

config APP_STATUS_PERIOD_S
	int "Seconds between status lines on the console (0 = off)"
	default 5

config APP_ZENOH
	bool "zenoh-pico client (t1s/sam<id>/hello, /cmd, /ack)"
	default y

config APP_ZENOH_LOCATOR
	string "zenohd to connect to (shell `zenoh <locator>` overrides, saved)"
	default "tcp/192.168.100.51:7448"
	depends on APP_ZENOH

config APP_PTP_MASTER
	string "Lock the LAN8651 clock to this sync answerer at boot (empty = only by hand)"
	default "192.168.100.65"
	help
	  The ESP gateway (`mode node` + `gw on`) answers the UDP 5007 exchange with hardware stamps.
	  The lock runs for ever: re-locked after a lost master, offset in t1s/sam<id>/hello.

config APP_ROLE
	string "Vehicle-zone role when neither a saved role nor the MAC table names one (empty = from the PLCA id)"
	default ""
	help
	  The role is the ECU name on the Vehicle API (ecu/<role>/...): zone-left, zone-right, zone-rear, ...
	  Order at boot: saved (`zone role <name>`) > the MAC table in main.c > this > the PLCA id's parity
	  (odd zone-left, even zone-right: the two-node bench's old rule).

menu "Remote access (bus shell, firmware update)"

config APP_BUS_SHELL
	bool "Console over the bus: \"ash\"/\"sh\" commands on ecu/<role>/cmd run on the dummy shell"
	default y
	depends on APP_ZENOH && SHELL_BACKEND_DUMMY
	help
	  Off for a release build (apps/node/release.conf): the node then answers every shell request with
	  "sh:(disabled)".

config APP_BUS_SHELL_AUTH
	bool "Bus shell commands must carry an HMAC-SHA256 tag (ash <ctr> <tag> <cmd>)"
	default y
	depends on APP_BUS_SHELL
	select TINYCRYPT
	select TINYCRYPT_SHA256
	select TINYCRYPT_SHA256_HMAC
	help
	  tag = first 16 bytes (hex) of HMAC-SHA256(key, "<bn>|<id>|<ctr>|<cmd>"), bn = the node's per-boot nonce
	  (in its heartbeat), id = its PLCA id, ctr = a decimal counter that must grow (the PC's time in ms).
	  The key is a build-time secret: the file BUS_KEY_FILE (default ~/.config/t1s-keys/bus.key, 64 hex digits),
	  never in the repository. A build without the file refuses every command (fail closed).
	  n = the old unauthenticated "sh <cmd>" (bench only).

config APP_BUS_SHELL_ALLOW
	string "Commands the bus shell may run (';' list; an entry matches the command or its prefix + ' ', '$' = exact)"
	default "t1s status;t1s diag;t1s sleep;t1s wake;panel;ptp$;zenoh$;zone;ota;irqlat;kernel uptime$;kernel stacks$;kernel thread stacks$;net iface$;net ping"
	depends on APP_BUS_SHELL
	help
	  Not on the list by default: register writes (t1s reg), identity changes (t1s plca/ip/save/forget),
	  the router (zenoh <locator>), PTP master changes (ptp lock), reboot (SMP has its own).

config APP_SMP_FILTER
	bool "Filter mcumgr SMP/UDP (port 1337) in the IPv4 input: source address and arming"
	default y
	depends on MCUMGR_TRANSPORT_UDP
	select NET_PKT_FILTER
	select NET_PKT_FILTER_IPV4_HOOK

config APP_SMP_ALLOWED_SRC
	string "The only IPv4 source SMP is taken from (empty = any)"
	default "192.168.100.51"
	depends on APP_SMP_FILTER

config APP_SMP_ARM
	bool "SMP is closed until armed (`ota arm [s]`, through the authenticated bus shell or the USB console)"
	default y
	depends on APP_SMP_FILTER

config APP_SMP_ARM_S
	int "Default arming window, seconds"
	default 300
	depends on APP_SMP_ARM

config APP_CONFIRM_TIMEOUT_S
	int "A test-booted image confirms itself only after a health check; not healthy after this many seconds = reboot unconfirmed (MCUboot reverts)"
	default 180
	help
	  Healthy = PLCA beacons heard, Zenoh connected and the first heartbeat put out (and, with
	  APP_CONFIRM_NEED_VEHICLE, one vehicle key received).

config APP_CONFIRM_NEED_SMP
	bool "The health check also waits for an SMP request taken through the filter: the image must be updatable again"
	default y
	depends on APP_SMP_FILTER
	help
	  tools/smp_udp.py update arms the node (authenticated bus command) and lists its slots after the reset, which is
	  that request. An image whose bus shell key, arming or SMP filter does not work is therefore never confirmed and
	  goes back by itself -- instead of staying on a node that could then only be reached over SWD.

config APP_CONFIRM_NEED_VEHICLE
	bool "The health check also waits for a vehicle key (the car must be running during an update)"
	default n

endmenu

config APP_IRQ_PROBE
	bool "IRQ latency probe: TC4 interrupt every 8 ms at the EIC's priority, `irqlat` shows the delay"
	default y

source "Kconfig.zephyr"
```

## Kconfig.sysbuild
```
# SPDX-License-Identifier: Apache-2.0
# Sysbuild options of this app: the MCUboot signing key from the environment, never from the repository.
#
#   T1S_SIGNING_KEY=~/.config/t1s-keys/mcuboot-rsa-2048.pem west build --sysbuild ...   (tools/build_node.sh sets it)
#
# Unset = MCUboot's public development key (root-rsa-2048.pem): what nodes 3 and 4 still carry in their bootloader,
# so their OTA images must keep being signed with it until their MCUboot is reflashed over SWD (README).
# The key's public half is built into MCUboot: changing it means flashing MCUboot again, which OTA cannot do.

config BOOT_SIGNATURE_KEY_FILE
	string
	default "$(T1S_SIGNING_KEY)" if "$(T1S_SIGNING_KEY)" != ""

source "share/sysbuild/Kconfig"
```

## sysbuild.conf
```
# MCUboot in front of the app, so nodes can be updated over T1S (mcumgr SMP/UDP).
# Development signing key from the MCUboot tree: fine for a bench, not for a car.
SB_CONFIG_BOOTLOADER_MCUBOOT=y
```

## prj.conf
```kconfig
CONFIG_LOG=y
CONFIG_ETHERNET_LOG_LEVEL_INF=y
CONFIG_NET_LOG=y

CONFIG_GPIO=y
CONFIG_SPI=y
CONFIG_I2C=y

CONFIG_NETWORKING=y
CONFIG_NET_L2_ETHERNET=y
CONFIG_NET_L2_ETHERNET_MGMT=y
CONFIG_NET_IPV4=y
CONFIG_NET_IPV6=n
CONFIG_NET_ARP=y
CONFIG_NET_UDP=y
CONFIG_NET_TCP=y
CONFIG_NET_ICMPV4_ACCEPT_BROADCAST=y
CONFIG_NET_STATISTICS=y
CONFIG_NET_STATISTICS_PER_INTERFACE=y
CONFIG_NET_MGMT=y
CONFIG_NET_MGMT_EVENT=y
CONFIG_NET_PKT_RX_COUNT=32
CONFIG_NET_PKT_TX_COUNT=24
CONFIG_NET_BUF_RX_COUNT=64
CONFIG_NET_BUF_TX_COUNT=48
CONFIG_NET_MAX_CONTEXTS=12

# Static IPv4 (bench T1S subnet; EVB-LAN8670 on the PC uses .70)
CONFIG_NET_CONFIG_SETTINGS=y
CONFIG_NET_CONFIG_NEED_IPV4=y
CONFIG_NET_CONFIG_MY_IPV4_ADDR="192.168.100.71"
CONFIG_NET_CONFIG_MY_IPV4_NETMASK="255.255.255.0"
CONFIG_NET_CONFIG_INIT_TIMEOUT=0

CONFIG_SHELL=y
CONFIG_NET_SHELL=y
CONFIG_SHELL_STACK_SIZE=3072
# the console over the bus ("ash <ctr> <tag> <cmd>" on ecu/<role>/cmd, zone_zenoh.c): commands run on the dummy backend.
# Access control: Kconfig APP_BUS_SHELL / APP_BUS_SHELL_AUTH / APP_BUS_SHELL_ALLOW; release.conf turns it off.
CONFIG_SHELL_BACKEND_DUMMY=y
CONFIG_SHELL_BACKEND_DUMMY_BUF_SIZE=1024
CONFIG_SHELL_DUMMY_INIT_LOG_LEVEL_NONE=y

CONFIG_MAIN_STACK_SIZE=4096
CONFIG_SYSTEM_WORKQUEUE_STACK_SIZE=2048
CONFIG_ETH_LAN865X_IRQ_THREAD_STACK_SIZE=1536
CONFIG_HEAP_MEM_POOL_SIZE=65536
CONFIG_NET_STATISTICS_USER_API=y

# Identity kept across reboots (`t1s save`): settings on NVS in storage_partition
CONFIG_FLASH=y
CONFIG_FLASH_MAP=y
CONFIG_NVS=y
CONFIG_SETTINGS=y
CONFIG_SETTINGS_NVS=y

# Network firmware update: mcumgr SMP over UDP (port 1337) into MCUboot's second slot. Filtered by zone_guard.c:
# source CONFIG_APP_SMP_ALLOWED_SRC only, and only while armed (`ota arm`). release.conf turns the transport off.
# Only takes effect in a sysbuild with MCUboot (sysbuild.conf); tools/smp_udp.py is the client.
CONFIG_NET_SOCKETS=y
CONFIG_ZCBOR=y
CONFIG_MCUMGR=y
CONFIG_MCUMGR_TRANSPORT_UDP=y
CONFIG_MCUMGR_TRANSPORT_UDP_IPV4=y
CONFIG_MCUMGR_TRANSPORT_UDP_IPV6=n
CONFIG_MCUMGR_GRP_IMG=y
CONFIG_MCUMGR_GRP_OS=y
CONFIG_MCUMGR_GRP_OS_RESET_HOOK=n
CONFIG_IMG_MANAGER=y
CONFIG_STREAM_FLASH=y
CONFIG_MCUMGR_TRANSPORT_NETBUF_SIZE=1024
CONFIG_MCUMGR_TRANSPORT_UDP_STACK_SIZE=2048
CONFIG_REBOOT=y

# zenoh-pico client (src/zone_zenoh.c): POSIX sockets + pthreads, k_malloc heap
CONFIG_ZENOH_PICO=y
CONFIG_ZENOH_PICO_MULTI_THREAD=y
CONFIG_ZENOH_PICO_PUBLICATION=y
CONFIG_ZENOH_PICO_SUBSCRIPTION=y
CONFIG_ZENOH_PICO_LINK_TCP=y
CONFIG_ZENOH_PICO_THREADS_NUM=3
CONFIG_POSIX_API=y
CONFIG_ENTROPY_GENERATOR=y
CONFIG_DNS_RESOLVER=y
CONFIG_DNS_SERVER_IP_ADDRESSES=n
CONFIG_NET_SOCKETS_POLL_MAX=8
CONFIG_ZVFS_OPEN_MAX=16
CONFIG_NET_MAX_CONN=12
# zenoh-pico makes a mutex/condvar per session object; the POSIX pools default to ~5
CONFIG_MAX_PTHREAD_MUTEX_COUNT=64
CONFIG_MAX_PTHREAD_COND_COUNT=32
CONFIG_POSIX_THREAD_THREADS_MAX=8
CONFIG_CBPRINTF_FP_SUPPORT=y

# PTP clock device + frame stamps from the LAN8651 (zephyr-patches/): used by the UDP 5007 lock and
# the lamps' blink phase. Standard gPTP is NOT on by default: with two SAM nodes its servo would steer
# the same TSU as the lock to the gateway. Experiments: -DEXTRA_CONF_FILE=gptp.conf (and no `ptp lock`).
CONFIG_PTP_CLOCK=y
CONFIG_NET_PKT_TIMESTAMP=y

# Hardware watchdog (main loop feeds it) and stack headroom (`kernel thread stacks`)
CONFIG_WATCHDOG=y
CONFIG_WDT_DISABLE_AT_BOOT=n
CONFIG_INIT_STACKS=y
CONFIG_THREAD_STACK_INFO=y
CONFIG_THREAD_MONITOR=y
CONFIG_THREAD_NAME=y
CONFIG_KERNEL_SHELL=y

# diagnostics: per-pool usage in 'net mem'
CONFIG_NET_BUF_POOL_USAGE=y
CONFIG_NET_DEBUG_NET_PKT_ALLOC=y

# Socket receive/send timeouts (SO_RCVTIMEO): off by default, and then every timeout is silently
# ignored -- the PTP lock hung for ever on one lost reply, zenoh-pico's reads never time out.
CONFIG_NET_CONTEXT_RCVTIMEO=y
CONFIG_NET_CONTEXT_SNDTIMEO=y
```

## gptp.conf
```kconfig
# Standard 802.1AS gPTP (Zephyr's stack) on the LAN8651 TSU. gPTP's 01:80:C2:00:00:0E is not in the
# MAC filter: main.c sets the MAC's copy-all bit (NOT Zephyr promiscuous mode, which leaks the RX pool).
# Do not run `ptp lock` at the same time: both servos would steer the same clock.
CONFIG_NET_GPTP=y
CONFIG_NET_GPTP_STATISTICS=y
CONFIG_NET_GPTP_LOG_LEVEL_ERR=y
CONFIG_NET_L2_PTP=n
CONFIG_APP_PTP_MASTER=""
```

## panel-spi.conf
```kconfig
# the 10x10 panel's WS2812 data through SERCOM0 + DMA (dts/panel-slot2.overlay, zone_panel.c `panel drv spi`);
# added by CMakeLists.txt when PANEL_SLOT is 2
CONFIG_SPI_ASYNC=y
CONFIG_DMA=y
```

## ptp1588.conf
```kconfig
# Experiment (docs/2026-11-02_HARDENING.md, item 3): Zephyr's IEEE 1588 stack (UDP/IPv4, E2E, ordinary clock) on the
# LAN8651 TSU, beside the UDP 5007 lock. Domain 77 (set in ptp.c: no Kconfig for it in 3.7) so no PTP slave on the
# bench LAN follows it by accident.
# -Dnode_EXTRA_CONF_FILE=ptp1588.conf. Not with gptp.conf (Zephyr: PTP depends on !NET_GPTP).
CONFIG_PTP=y
CONFIG_PTP_UDP_IPv4_PROTOCOL=y
CONFIG_PTP_ORDINARY_CLOCK=y
CONFIG_PTP_PRIORITY1=250
CONFIG_PTP_LOG_LEVEL_WRN=y
CONFIG_NET_L2_PTP=y
```

## release.conf
```kconfig
# Release build: no remote shell and no network firmware update on the node (EXTRA_CONF_FILE=release.conf,
# or -Dnode_EXTRA_CONF_FILE=release.conf in a sysbuild). Updates then go through SWD only -- or leave
# MCUMGR_TRANSPORT_UDP on and rely on the SMP filter (source address + `ota arm`), see README.
CONFIG_APP_BUS_SHELL=n
CONFIG_MCUMGR_TRANSPORT_UDP=n
CONFIG_MCUMGR=n
CONFIG_IMG_MANAGER=n
CONFIG_STREAM_FLASH=n
CONFIG_SHELL_BACKEND_DUMMY=n
```

## src/ptp.c
```c
/*
 * Time sync on the LAN8651's own 1588 clock (TSU, 25 MHz, 40 ns ticks), with hardware stamps at
 * the SFD on the wire. Same exchange and wire format as the ESP T1S HAT firmware
 * (elite-t1s-hat/firmware, `sync` / `ptp on` / `ptp lock`), so either board can be master:
 *
 *   asker  -> SYNC {magic, seq, t1 (us, asker's uptime), 0, 0}            UDP 5007
 *   answer <- SYNC {magic, seq, t1, t2, t3 (us, answerer's uptime)}
 *   answer <- SYNF {magic, seq, t1, t2, t3 (ns, answerer's LAN8651 clock)}  hardware follow-up
 *
 * `ptp on` makes the stamps (TSU increment, packet matcher on every frame, the driver hooks);
 * the answering side runs always. `ptp lock <ip> [sec] [kp] [ki]` disciplines this node's clock to
 * <ip>'s: 16 exchanges a second, the min-delay one, one step, then PI on the TSU frequency.
 * Offset printed = master - node (ns).
 *
 * SPDX-License-Identifier: Apache-2.0
 */
#include <stdlib.h>
#include <string.h>
#include <zephyr/kernel.h>
#include <zephyr/net/socket.h>
#include <zephyr/net/net_pkt.h>
#include <zephyr/random/random.h>
#include <zephyr/shell/shell.h>
#include <zephyr/logging/log.h>
#include "t1s_diag.h"
#include "oa_tc6.h"
#include "zone.h"

LOG_MODULE_REGISTER(zone_ptp, LOG_LEVEL_INF);

#define SYNC_PORT 5007
#define SYNC_MAGIC 0x53594e43u  /* "SYNC" */
#define SYNC_FOLLOW 0x53594e46u /* "SYNF" */

struct sync_msg {
	uint32_t magic, seq;
	int64_t t1, t2, t3;
};

static const struct device *const t1s = DEVICE_DT_GET(DT_NODELABEL(t1s0));
static bool ptp_on;
static uint32_t n_rx_ts, n_sync_rx, n_tx_ask, n_tx_got, n_tx_miss, n_fu;

struct hw_stamp {
	volatile uint32_t seq;
	volatile int64_t ns;
};
static struct hw_stamp rx_stamp[64];

static int64_t ts_to_ns(uint64_t ts)
{
	return (int64_t)(ts >> 32) * 1000000000LL + (int64_t)(ts & 0xffffffffu);
}

static int64_t now_us(void)
{
	return k_ticks_to_us_floor64(k_uptime_ticks());
}

/* The UDP payload of an IPv4 frame on port 5007, copied out of the packet: its magic and seq. */
static bool sync_of(struct net_pkt *pkt, uint32_t *magic, uint32_t *seq)
{
	uint8_t f[14 + 60 + 8 + 8];
	size_t len = MIN(net_pkt_get_len(pkt), sizeof(f));

	net_pkt_cursor_init(pkt);
	if (net_pkt_read(pkt, f, len)) {
		net_pkt_cursor_init(pkt);
		return false;
	}
	net_pkt_cursor_init(pkt);
	if (len < 14 + 20 + 8 + 8 || f[12] != 0x08 || f[13] != 0x00) {
		return false;
	}
	const uint8_t *ip = f + 14;
	size_t ihl = (ip[0] & 0x0f) * 4;

	if (ip[9] != 17 || len < 14 + ihl + 8 + 8) {
		return false;
	}
	const uint8_t *u = ip + ihl;
	uint16_t sp = u[0] << 8 | u[1], dp = u[2] << 8 | u[3];

	if (sp != SYNC_PORT && dp != SYNC_PORT) {
		return false;
	}
	memcpy(magic, u + 8, 4);
	memcpy(seq, u + 12, 4);
	return true;
}

static void on_rx_ts(struct net_pkt *pkt, uint64_t ts)
{
	uint32_t magic, seq;

	n_rx_ts++;
	if (sync_of(pkt, &magic, &seq) && magic == SYNC_MAGIC) {
		rx_stamp[seq & 63].ns = ts_to_ns(ts);
		rx_stamp[seq & 63].seq = seq;
		n_sync_rx++;
	}
}

static bool want_tx_ts(struct net_pkt *pkt)
{
	uint32_t magic, seq;

	if (sync_of(pkt, &magic, &seq) && magic == SYNC_MAGIC) { /* not the follow-up */
		n_tx_ask++;
		return true;
	}
	return false;
}

static int64_t take_tx_stamp(void)
{
	uint64_t ts;

	if (t1s_take_tx_stamp(t1s, &ts, 20) == 0) {
		n_tx_got++;
		return ts_to_ns(ts);
	}
	n_tx_miss++;
	return -1;
}

#define MMS1(a) (0x10000u | (a))
#define MMS4(a) (0x40000u | (a))

static int64_t tsu_now(void) /* TN first, then TSL: the order the datasheet latches */
{
	uint32_t ns = 0, sl = 0;

	t1s_reg_read(t1s, MMS1(0x75), &ns);
	t1s_reg_read(t1s, MMS1(0x74), &sl);
	return (int64_t)sl * 1000000000LL + ns;
}

static void tsu_step(int64_t d) /* add d ns: TA below 1 s, else set seconds / ns */
{
	if (d > -1000000000LL && d < 1000000000LL) {
		uint32_t v = (d < 0 ? 0x80000000u : 0) | (uint32_t)((d < 0 ? -d : d) & 0x3fffffff);

		t1s_reg_write(t1s, MMS1(0x76), v);
	} else {
		int64_t t = tsu_now() + d;

		t1s_reg_write(t1s, MMS1(0x75), (uint32_t)(t % 1000000000LL));
		t1s_reg_write(t1s, MMS1(0x74), (uint32_t)(t / 1000000000LL));
	}
}

static void tsu_freq(double ppb) /* increment = 40 ns x (1 + ppb e-9), 2^-24 ns resolution */
{
	uint64_t inc = (uint64_t)(40.0 * 16777216.0 * (1.0 + ppb * 1e-9) + 0.5);
	uint32_t ti = inc >> 24, sub = inc & 0xffffff;

	t1s_reg_write(t1s, MMS1(0x6f), (sub & 0xff) << 24 | ((sub >> 8) & 0xffff)); /* TISUBN first */
	t1s_reg_write(t1s, MMS1(0x77), ti);
}

static void ptp_enable(bool on)
{
	/* The stamp is triggered by the PHY's packet matcher at the SFD, which out of reset is off
	 * and set for gPTP Sync only: match every frame (mask 0xFFFFFF, location 0), TX and RX. */
	static const uint16_t mm[][2] = {{0x43, 0x00ff}, {0x44, 0xffff}, {0x45, 0},
					 {0x53, 0x00ff}, {0x54, 0xffff}, {0x55, 0}};

	t1s_reg_write(t1s, MMS1(0x77), 40);
	for (size_t i = 0; i < ARRAY_SIZE(mm); i++) {
		t1s_reg_write(t1s, MMS4(mm[i][0]), mm[i][1]);
	}
	t1s_reg_write(t1s, MMS4(0x40), on ? 2 : 0); /* TXMCTL.TXME */
	t1s_reg_write(t1s, MMS4(0x50), on ? 2 : 0); /* RXMCTL.RXME */
	oa_tc6_rx_ts_cb = on ? on_rx_ts : NULL;
	oa_tc6_tx_ts_want = on ? want_tx_ts : NULL;
	ptp_on = on;
}

/* ------------------------------------------------------------------ answering side */
static void sync_server(void *a, void *b, void *c)
{
	int s = zsock_socket(AF_INET, SOCK_DGRAM, IPPROTO_UDP);
	struct sockaddr_in me = {.sin_family = AF_INET, .sin_port = htons(SYNC_PORT)};
	struct sync_msg m;

	zsock_bind(s, (struct sockaddr *)&me, sizeof(me));
	for (;;) {
		struct sockaddr_in from;
		socklen_t fl = sizeof(from);

		if (zsock_recvfrom(s, &m, sizeof(m), 0, (struct sockaddr *)&from, &fl) != sizeof(m) ||
		    m.magic != SYNC_MAGIC) {
			continue;
		}
		m.t2 = now_us();
		m.t3 = now_us();
		zsock_sendto(s, &m, sizeof(m), 0, (struct sockaddr *)&from, fl);
		if (ptp_on) { /* like PTP's Follow_Up: the precise times after the message */
			int64_t t3h = take_tx_stamp();
			struct hw_stamp r = rx_stamp[m.seq & 63];
			struct sync_msg fu = {SYNC_FOLLOW, m.seq, m.t1, r.seq == m.seq ? r.ns : -1, t3h};

			n_fu++;
			zsock_sendto(s, &fu, sizeof(fu), 0, (struct sockaddr *)&from, fl);
		}
	}
}
K_THREAD_DEFINE(sync_tid, 2048, sync_server, NULL, NULL, NULL, 6, 0, 3000);

/* ------------------------------------------------------------------ servo (`ptp lock`) */
static volatile bool lock_run;
static char lock_host[16];
static int lock_secs = 60;
static double lock_kp = 0.2, lock_ki = 0.02; /* the ESP bench's measured best; ptp4l uses 0.7 / 0.3 */
volatile int64_t ptp_last_offset_ns = INT64_MIN;
volatile int64_t ptp_last_delay_ns;

static void lock_thread(void *a, void *b, void *c)
{
	for (;;) {
		while (!lock_run) {
			k_msleep(200);
		}
		int s = zsock_socket(AF_INET, SOCK_DGRAM, IPPROTO_UDP);
		struct sockaddr_in to = {.sin_family = AF_INET, .sin_port = htons(SYNC_PORT)};
		struct timeval tv = {0, 30000}, tf = {0, 5000};
		double integ = 0, freq = 0;
		bool stepped = false;
		/*
		 * The path delay is a constant of the wire (19.80 us +- 1 ns on the bench). An exchange whose delay is far
		 * from it was mis-paired -- a missed egress capture leaves the previous frame's stamp as t1, which makes the
		 * delay look *shorter*, so the min-delay pick chose exactly those: 14 us kicks and ~10 s of ringing on one
		 * node (2026-10-28). Once the delay is known, such exchanges are dropped.
		 */
		int64_t dly_ref = INT64_MIN;
		uint32_t n_dly_drop = 0;
		uint32_t seq = 0x40000000u;

		zsock_inet_pton(AF_INET, lock_host, &to.sin_addr);
		zsock_setsockopt(s, SOL_SOCKET, SO_RCVTIMEO, &tv, sizeof(tv));
		tsu_freq(0);
		printk("ptpl: locking the LAN8651 clock to %s for %d s (kp %.2f ki %.3f)\n", lock_host,
		       lock_secs, lock_kp, lock_ki);
		int quiet = 0;

		for (int sec = 0; (lock_secs == 0 || sec < lock_secs) && lock_run; sec++) {
			int64_t best_off = 0, best_dly = INT64_MAX;
			int ok = 0;

			for (int k = 0; k < 16; k++) {
				struct sync_msg m = {SYNC_MAGIC, ++seq, now_us(), 0, 0}, in, fu;
				bool got = false;

				zsock_sendto(s, &m, sizeof(m), 0, (struct sockaddr *)&to, sizeof(to));
				int64_t t1 = take_tx_stamp();

				while (zsock_recv(s, &in, sizeof(in), 0) == sizeof(in)) {
					if (in.magic == SYNC_MAGIC && in.seq == m.seq) {
						got = true;
						break;
					}
				}
				int64_t t2 = in.t2 * 1000, t3 = in.t3 * 1000;
				bool hw = false;

				if (got) {
					zsock_setsockopt(s, SOL_SOCKET, SO_RCVTIMEO, &tf, sizeof(tf));
					while (zsock_recv(s, &fu, sizeof(fu), 0) == sizeof(fu)) {
						if (fu.seq != m.seq) {
							continue;
						}
						if (fu.magic == SYNC_FOLLOW && fu.t2 >= 0 && fu.t3 >= 0) {
							t2 = fu.t2;
							t3 = fu.t3;
							hw = true;
						}
						break;
					}
					zsock_setsockopt(s, SOL_SOCKET, SO_RCVTIMEO, &tv, sizeof(tv));
				}
				struct hw_stamp r = rx_stamp[m.seq & 63];

				if (got && hw && t1 >= 0 && r.seq == m.seq) {
					int64_t t4 = r.ns;
					int64_t off = ((t2 - t1) + (t3 - t4)) / 2;
					int64_t dly = ((t4 - t1) - (t3 - t2)) / 2;

					if (dly_ref != INT64_MIN && (dly - dly_ref > 300 || dly_ref - dly > 300)) {
						n_dly_drop++;
						k_usleep(sys_rand32_get() % 1000);
						k_msleep(54);
						continue;
					}
					if (dly < best_dly) {
						best_dly = dly;
						best_off = off;
					}
					ok++;
				}
				k_usleep(sys_rand32_get() % 1000);
				k_msleep(54);
			}
			if (!ok) {
				ptp_last_offset_ns = INT64_MIN;
				if (++quiet % 10 == 1) {
					printk("ptpl: %d s no hardware-stamped answers from %s\n", sec, lock_host);
				}
				if (quiet > 5) {
					stepped = false; /* master gone a while: step again when it is back */
				}
				continue;
			}
			quiet = 0;
			if (stepped && (best_off > 1000000 || best_off < -1000000)) {
				stepped = false; /* > 1 ms off (master restarted): step instead of slewing */
			}
			if (!stepped) {
				tsu_step(best_off);
				stepped = true;
				dly_ref = INT64_MIN; /* learnt again after the step */
				printk("ptpl: %d step %lld ns\n", sec, (long long)best_off);
				continue;
			}
			/* the reference follows the accepted delays slowly (a real cable change re-learns within ~a minute,
			 * or at the next step) */
			dly_ref = dly_ref == INT64_MIN ? best_dly : dly_ref + (best_dly - dly_ref) / 16;
			integ += lock_ki * best_off;
			freq = lock_kp * best_off + integ; /* ppb, + = node slow -> speed up */
			freq = CLAMP(freq, -200000, 200000);
			tsu_freq(freq);
			ptp_last_offset_ns = best_off;
			ptp_last_delay_ns = best_dly;
			if (lock_secs || sec % 10 == 0) { /* for ever: one line per 10 s */
				printk("ptpl: %d offset %lld ns delay %lld ns freq %+d ppb (%d/16, %u mis-paired dropped)\n", sec,
				       (long long)best_off, (long long)best_dly, (int)freq, ok, n_dly_drop);
			}
		}
		zsock_close(s);
		printk("ptpl: done, holding %+d ppb\n", (int)freq);
		lock_run = false;
	}
}
K_THREAD_DEFINE(lock_tid, 3072, lock_thread, NULL, NULL, NULL, 5, 0, 3000);

/* At boot: once the coordinator's beacons are heard, hardware stamps on and a lock for ever. */
static void ptp_auto(void *a, void *b, void *c)
{
	if (!strlen(CONFIG_APP_PTP_MASTER)) {
		return;
	}
	while (!zone_bus_up()) {
		k_msleep(500);
	}
	k_msleep(3000);
	ptp_enable(true);
	strncpy(lock_host, CONFIG_APP_PTP_MASTER, sizeof(lock_host) - 1);
	lock_secs = 0;
	lock_kp = 0.7; /* hardware stamps on both ends: ptp4l's gains (measured 2026-10-27) */
	lock_ki = 0.3;
	lock_run = true;
	LOG_INF("ptp: locking to %s for ever", lock_host);
}
K_THREAD_DEFINE(ptp_auto_tid, 1024, ptp_auto, NULL, NULL, NULL, 9, 0, 4000);

int64_t zone_ptp_offset_ns(void) { return lock_run ? ptp_last_offset_ns : INT64_MIN; }

static int cmd_ptp(const struct shell *sh, size_t argc, char **argv)
{
	if (argc > 1 && (!strcmp(argv[1], "on") || !strcmp(argv[1], "off"))) {
		ptp_enable(!strcmp(argv[1], "on"));
	} else if (argc > 2 && !strcmp(argv[1], "lock")) {
		if (!ptp_on) {
			shell_print(sh, "ptpl: run `ptp on` first");
			return -EINVAL;
		}
		strncpy(lock_host, argv[2], sizeof(lock_host) - 1);
		lock_secs = argc > 3 ? CLAMP(atoi(argv[3]), 0, 86400) : 60; /* 0 = for ever */
		lock_kp = argc > 4 ? strtod(argv[4], NULL) : 0.2;
		lock_ki = argc > 5 ? strtod(argv[5], NULL) : 0.02;
		lock_run = true;
		return 0;
	} else if (argc > 1 && !strcmp(argv[1], "stop")) {
		lock_run = false;
		return 0;
	} else if (argc > 1) {
		shell_print(sh, "ptp [on|off] | ptp lock <master ip> [sec] [kp] [ki] | ptp stop");
		return -EINVAL;
	}
	uint32_t c0 = 0, ti = 0;
	int64_t now = tsu_now();

	t1s_reg_read(t1s, 0x00000004, &c0);
	t1s_reg_read(t1s, MMS1(0x77), &ti);
	shell_print(sh, "ptp: %s, OA_CONFIG0 0x%08x (FTSE %u FTSS %u), TSU increment %u ns, clock %lld.%09lld s",
		    ptp_on ? "hardware stamps on" : "off", c0, (c0 >> 7) & 1, (c0 >> 6) & 1, ti,
		    (long long)(now / 1000000000LL), (long long)(now % 1000000000LL));
	shell_print(sh, "ptp: ingress stamps %u (sync %u), egress asked %u got %u missed %u, follow-ups %u, "
		    "lock %s, last offset %lld ns delay %lld ns", n_rx_ts, n_sync_rx, n_tx_ask, n_tx_got,
		    n_tx_miss, n_fu, lock_run ? lock_host : "off",
		    (long long)(ptp_last_offset_ns == INT64_MIN ? 0 : ptp_last_offset_ns),
		    (long long)ptp_last_delay_ns);
	return 0;
}
SHELL_CMD_REGISTER(ptp, NULL, "ptp [on|off] | ptp lock <ip> [sec] [kp] [ki] | ptp stop", cmd_ptp);

#ifdef CONFIG_PTP
/*
 * Experiment (ptp1588.conf): Zephyr 3.7's IEEE 1588 stack has no Kconfig for the domain and announces in domain 0,
 * which any PTP slave on the bench LAN (behind the ESP bridge) would follow. Moved to domain 77 before the first
 * Announce (the stack reads the default data set at every send).
 */
#include <subsys/net/lib/ptp/clock.h>
static int ptp1588_domain(void)
{
	((struct ptp_default_ds *)ptp_clock_default_ds())->domain = 77;
	return 0;
}
SYS_INIT(ptp1588_domain, APPLICATION, 50);
#endif
```

## src/t1s_diag.c
```c
/* SPDX-License-Identifier: Apache-2.0 */
#include "t1s_diag.h"
#include <zephyr/kernel.h>
#include "eth_lan865x_priv.h"
#include "oa_tc6.h"

static int rd(struct lan865x_data *ctx, uint32_t reg, uint32_t *v)
{
	*v = 0;
	return oa_tc6_reg_read(ctx->tc6, reg, v);
}

int t1s_read_status(const struct device *dev, struct t1s_status *st)
{
	struct lan865x_data *ctx = dev->data;
	int err = 0;

	if (k_sem_take(&ctx->tx_rx_sem, K_MSEC(200)) != 0) {
		return -EBUSY;
	}
	err |= rd(ctx, 0x000A0094, &st->devid);
	err |= rd(ctx, 0x0004CA00, &st->plca_idver);
	err |= rd(ctx, 0x0004CA01, &st->plca_ctrl0);
	err |= rd(ctx, 0x0004CA02, &st->plca_ctrl1);
	err |= rd(ctx, 0x0004CA03, &st->plca_sts);
	err |= rd(ctx, 0x0004CA04, &st->plca_totmr);
	err |= rd(ctx, 0x0004CA05, &st->plca_burst);
	err |= rd(ctx, 0x00000008, &st->oa_status0);
	err |= rd(ctx, 0x0000FF01, &st->phy_bmsr);
	k_sem_give(&ctx->tx_rx_sem);
	return err ? -EIO : 0;
}

int t1s_reg_read(const struct device *dev, uint32_t reg, uint32_t *val)
{
	struct lan865x_data *ctx = dev->data;

	if (k_sem_take(&ctx->tx_rx_sem, K_MSEC(200)) != 0) {
		return -EBUSY;
	}
	int ret = rd(ctx, reg, val);

	k_sem_give(&ctx->tx_rx_sem);
	return ret;
}

int t1s_reg_write(const struct device *dev, uint32_t reg, uint32_t val)
{
	struct lan865x_data *ctx = dev->data;

	if (k_sem_take(&ctx->tx_rx_sem, K_MSEC(200)) != 0) {
		return -EBUSY;
	}
	int ret = oa_tc6_reg_write(ctx->tc6, reg, val);

	k_sem_give(&ctx->tx_rx_sem);
	return ret;
}

/*
 * STATUS1 TTSCOF{A,B,C} (21..23) and TTSCM{A,B,C} (24..26): a capture that overflowed (a new one
 * while TTSCAA was still set, e.g. a frame that left after the reader gave up) blocks every later
 * capture until cleared, and IMASK1 masks them so the driver never sees them. Write-1-to-clear.
 */
#define STATUS1_TTSC_ERR (0x3fu << 21)

static void clear_capture(const struct device *dev)
{
	t1s_reg_write(dev, 0x00000009, STATUS1_TTSC_ERR);
	t1s_reg_write(dev, 0x00000008, BIT(8));
}

int t1s_take_tx_stamp(const struct device *dev, uint64_t *ts, int timeout_ms)
{
	struct lan865x_data *ctx = dev->data;
	struct oa_tc6 *tc6 = ctx->tc6;
	int ret = -EAGAIN;

	for (int i = 0; i < timeout_ms * 10; i++) {
		if (tc6->tx_ts_valid) { /* the driver's status check got there first */
			*ts = tc6->tx_ts;
			tc6->tx_ts_valid = false;
			ret = 0;
			break;
		}
		uint32_t st = 0, hi = 0, lo = 0;

		if (t1s_reg_read(dev, 0x00000008, &st) == 0 && (st & BIT(8))) { /* STATUS0.TTSCAA */
			t1s_reg_read(dev, 0x00000010, &hi);
			t1s_reg_read(dev, 0x00000011, &lo);
			*ts = (uint64_t)hi << 32 | lo;
			ret = 0;
			break;
		}
		k_busy_wait(100);
	}
	clear_capture(dev); /* never leave a stamp or an overflow behind for the next request */
	return ret;
}

#include <zephyr/drivers/gpio.h>

#define SLPCTL0 0x00040080 /* MMS4 0x80: SLPEN 15, WKINEN 14, MDIWKEN 13, SLPINHDLY 12:11, SLPCAL 6:3 (write 0) */
#define SLPCTL1 0x00040081 /* MMS4 0x81: WOPOL 7 (must be 1), WIPOL 5, MDIFWDEN 0 */

static volatile bool sleeping;

bool t1s_is_sleeping(void) { return sleeping; }

int t1s_sleep(const struct device *dev, uint16_t wake_sources)
{
	struct lan865x_data *ctx = dev->data;
	uint32_t v = 0;

	if (sleeping || k_sem_take(&ctx->tx_rx_sem, K_MSEC(500)) != 0) {
		return -EBUSY;
	}
	/* active-high WAKE_IN; on a WAKE_IN wake also signal the bus (MDI forward) so the segment wakes */
	oa_tc6_reg_write(ctx->tc6, SLPCTL1, BIT(7) | BIT(5) | BIT(0));
	oa_tc6_reg_read(ctx->tc6, SLPCTL0, &v);
	v &= ~(BIT(15) | BIT(14) | BIT(13) | (3u << 11) | (0xfu << 3));
	v |= (wake_sources & (BIT(14) | BIT(13))) | BIT(15);
	sleeping = true;
	oa_tc6_reg_write(ctx->tc6, SLPCTL0, v); /* SLPEN: the chip is gone after this write */
	return 0;
}

int t1s_wake(const struct device *dev, const struct gpio_dt_spec *wi)
{
	struct lan865x_data *ctx = dev->data;

	if (!sleeping) {
		return -EALREADY;
	}
	if (wi && wi->port) {
		gpio_pin_set_dt(wi, 1);
		k_busy_wait(100); /* tdet_wi max 40 us */
		gpio_pin_set_dt(wi, 0);
	}
	k_msleep(5);
	sleeping = false;
	k_sem_give(&ctx->tx_rx_sem); /* the driver finds SYNC lost and resets + reconfigures the chip */
	k_sem_give(&ctx->int_sem);
	return 0;
}
```

## src/t1s_diag.h
```c
/* SPDX-License-Identifier: Apache-2.0 */
#pragma once
#include <stdint.h>
#include <zephyr/device.h>
#include <zephyr/drivers/gpio.h>

struct t1s_status {
	uint32_t devid;      /* 0x0A0094: chip id << 4 | silicon rev */
	uint32_t plca_idver; /* 0x04CA00 */
	uint32_t plca_ctrl0; /* 0x04CA01: bit15 EN */
	uint32_t plca_ctrl1; /* 0x04CA02: NCNT << 8 | ID */
	uint32_t plca_sts;   /* 0x04CA03: bit15 PST (PLCA active: beacons seen/sent) */
	uint32_t plca_totmr; /* 0x04CA04 */
	uint32_t plca_burst; /* 0x04CA05 */
	uint32_t oa_status0; /* 0x000008 */
	uint32_t phy_bmsr;   /* 0x00FF01: clause-22 BMSR, bit2 link */
};

/* Reads LAN865x registers via the in-tree driver's OA TC6 helpers,
 * serialised with the driver's own SPI traffic. */
int t1s_read_status(const struct device *dev, struct t1s_status *st);

/* Raw LAN865x register access (reg = MMS << 16 | addr), serialised with the driver. */
int t1s_reg_read(const struct device *dev, uint32_t reg, uint32_t *val);
int t1s_reg_write(const struct device *dev, uint32_t reg, uint32_t val);

/* Egress stamp of the last frame sent with a capture request (seconds << 32 | ns).
 * Waits up to timeout_ms; -EAGAIN if none. Needs the zephyr LOCAL PATCH (zephyr-patches/). */
int t1s_take_tx_stamp(const struct device *dev, uint64_t *ts, int timeout_ms);

/* Sleep (LAN8650/1 DS60001734F 4.4): wake sources in SLPCTL0 bits (WKINEN 14, MDIWKEN 13). Holds the driver's
 * SPI lock until t1s_wake() so the driver does not reset (= wake) the sleeping chip. */
int t1s_sleep(const struct device *dev, uint16_t wake_sources);
/* Pulse WAKE_IN (given pin) and hand the chip back to the driver, which re-syncs it after the wake reset. */
int t1s_wake(const struct device *dev, const struct gpio_dt_spec *wi);
bool t1s_is_sleeping(void);
```

## src/vehicle_api.h
```c
/* generated by tools/apigen.py from api/vehicle_api.yaml (v1, VSS 6.1, #f41869c6) -- do not edit */
#pragma once
#include <stdint.h>

#define VAPI_VERSION 1
#define VAPI_HASH "f41869c6"
#define VAPI_VSS "6.1"

enum vapi_type { VAPI_T_BOOL, VAPI_T_BYTES, VAPI_T_F32, VAPI_T_I16, VAPI_T_I8, VAPI_T_JSON, VAPI_T_U16, VAPI_T_U8 };
enum vapi_qos { VAPI_Q_REALTIME = 0, VAPI_Q_INTERACTIVE = 1, VAPI_Q_DATA = 2, VAPI_Q_BACKGROUND = 3 };

#define VAPI_SPEED "vehicle/speed"
#define VAPI_SELECTEDGEAR "vehicle/powertrain/transmission/selectedgear"
#define VAPI_SELECTEDGEAR_TARGET "vehicle/powertrain/transmission/selectedgear/target"
#define VAPI_STEERINGWHEEL_ANGLE "vehicle/chassis/steeringwheel/angle"
#define VAPI_ACCELERATOR_PEDALPOSITION "vehicle/chassis/accelerator/pedalposition"
#define VAPI_BRAKE_PEDALPOSITION "vehicle/chassis/brake/pedalposition"
#define VAPI_LIGHT_TURN_LEFT_ISSIGNALING "vehicle/body/lights/directionindicator/left/issignaling"
#define VAPI_LIGHT_TURN_LEFT_ISSIGNALING_TARGET "vehicle/body/lights/directionindicator/left/issignaling/target"
#define VAPI_LIGHT_TURN_RIGHT_ISSIGNALING "vehicle/body/lights/directionindicator/right/issignaling"
#define VAPI_LIGHT_TURN_RIGHT_ISSIGNALING_TARGET "vehicle/body/lights/directionindicator/right/issignaling/target"
#define VAPI_LIGHT_HAZARD_ISSIGNALING "vehicle/body/lights/hazard/issignaling"
#define VAPI_LIGHT_HAZARD_ISSIGNALING_TARGET "vehicle/body/lights/hazard/issignaling/target"
#define VAPI_LIGHT_BRAKE_ISACTIVE "vehicle/body/lights/brake/isactive"
#define VAPI_LIGHT_BACKUP_ISON "vehicle/body/lights/backup/ison"
#define VAPI_BODY_HORN_ISACTIVE "vehicle/body/horn/isactive"
#define VAPI_BODY_HORN_ISACTIVE_TARGET "vehicle/body/horn/isactive/target"
#define VAPI_P_DRIVINGMODE "vehicle/private/drivingmode"
#define VAPI_P_LIGHTS_TURN_LEFT_ISLIT "vehicle/private/lights/directionindicator/left/islit"
#define VAPI_P_MRM_STATE "vehicle/private/mrm/state"
#define VAPI_P_LIGHTS_TURN_RIGHT_ISLIT "vehicle/private/lights/directionindicator/right/islit"
#define VAPI_LIGHT_BEAM_HIGH_ISON "vehicle/body/lights/beam/high/ison"
#define VAPI_LIGHT_BEAM_HIGH_ISON_TARGET "vehicle/body/lights/beam/high/ison/target"
#define VAPI_LIGHT_BEAM_HIGH_ISON_OLD "vehicle/private/zone/lights/beam/high" /* legacy, until migration step 5 */
#define VAPI_LIGHT_BEAM_LOW_ISON "vehicle/body/lights/beam/low/ison"
#define VAPI_LIGHT_RUNNING_ISON "vehicle/body/lights/running/ison"
#define VAPI_LIGHT_PARKING_ISON "vehicle/body/lights/parking/ison"
#define VAPI_P_LIGHT_AUTOMATEDDRIVING_ISON "vehicle/private/body/lights/automateddriving/ison"
#define VAPI_P_CABIN_STICK_X "vehicle/private/cabin/stick/x"
#define VAPI_P_CABIN_STICK_X_OLD "vehicle/private/zone/stick/x" /* legacy, until migration step 5 */
#define VAPI_P_CABIN_STICK_Y "vehicle/private/cabin/stick/y"
#define VAPI_P_CABIN_STICK_Y_OLD "vehicle/private/zone/stick/y" /* legacy, until migration step 5 */
#define VAPI_ADAS_OBST_REAR_CENTER_DISTANCE "vehicle/adas/obstacledetection/rear/center/distance"
#define VAPI_ADAS_OBST_REAR_CENTER_DISTANCE_OLD "vehicle/private/external/proximity_rear" /* legacy, until migration step 5 */
#define VAPI_ADAS_OBST_REAR_CENTER_ISWARNING "vehicle/adas/obstacledetection/rear/center/iswarning"
#define VAPI_ECU_STATUS "ecu/%s/status"
#define VAPI_ECU_STATUS_OLD "t1s/sam%u/hello" /* legacy, until migration step 5 */
#define VAPI_ECU_DISPLAY "ecu/%s/display"
#define VAPI_ECU_DISPLAY_OLD "t1s/sam%u/panel" /* legacy, until migration step 5 */
#define VAPI_ECU_DIAG_PROXIMITY_RAW "ecu/%s/diag/proximity_raw"
#define VAPI_ECU_DIAG_PROXIMITY_RAW_OLD "vehicle/private/zone/proximity/raw" /* legacy, until migration step 5 */
#define VAPI_ECU_CMD "ecu/%s/cmd"
#define VAPI_ECU_CMD_OLD "t1s/sam%u/cmd" /* legacy, until migration step 5 */
#define VAPI_ECU_CMD_ACK "ecu/%s/cmd/ack"
#define VAPI_ECU_CMD_ACK_OLD "t1s/sam%u/ack" /* legacy, until migration step 5 */
#define VAPI_CMD_NAME "vehicle/cmd/{name}"
#define VAPI_ECU_ADS_STATUS "ecu/ads/status"
#define VAPI_ECU_ALL_CMD "ecu/all/cmd"
#define VAPI_ECU_ALL_CMD_OLD "t1s/all/cmd" /* legacy, until migration step 5 */
#define VAPI_ECU_ALL_CONFIG_DISPLAY_VIEW "ecu/all/config/display_view"
#define VAPI_ECU_ALL_CONFIG_DISPLAY_VIEW_OLD "vehicle/private/zone/panel/view" /* legacy, until migration step 5 */

struct vapi_key { const char *key; uint8_t type, qos, target; uint16_t max_age_ms; };
static const struct vapi_key vapi_keys[] = {
	{VAPI_SPEED, VAPI_T_F32, VAPI_Q_INTERACTIVE, 0, 1000},
	{VAPI_SELECTEDGEAR, VAPI_T_I8, VAPI_Q_INTERACTIVE, 1, 2000},
	{VAPI_STEERINGWHEEL_ANGLE, VAPI_T_I16, VAPI_Q_INTERACTIVE, 0, 1000},
	{VAPI_ACCELERATOR_PEDALPOSITION, VAPI_T_U8, VAPI_Q_INTERACTIVE, 0, 1000},
	{VAPI_BRAKE_PEDALPOSITION, VAPI_T_U8, VAPI_Q_INTERACTIVE, 0, 1000},
	{VAPI_LIGHT_TURN_LEFT_ISSIGNALING, VAPI_T_BOOL, VAPI_Q_DATA, 1, 2000},
	{VAPI_LIGHT_TURN_RIGHT_ISSIGNALING, VAPI_T_BOOL, VAPI_Q_DATA, 1, 2000},
	{VAPI_LIGHT_HAZARD_ISSIGNALING, VAPI_T_BOOL, VAPI_Q_DATA, 1, 2000},
	{VAPI_LIGHT_BRAKE_ISACTIVE, VAPI_T_BOOL, VAPI_Q_REALTIME, 0, 2000},
	{VAPI_LIGHT_BACKUP_ISON, VAPI_T_BOOL, VAPI_Q_DATA, 0, 2000},
	{VAPI_BODY_HORN_ISACTIVE, VAPI_T_BOOL, VAPI_Q_DATA, 1, 2000},
	{VAPI_P_DRIVINGMODE, VAPI_T_U8, VAPI_Q_INTERACTIVE, 0, 2000},
	{VAPI_P_LIGHTS_TURN_LEFT_ISLIT, VAPI_T_BOOL, VAPI_Q_DATA, 0, 2000},
	{VAPI_P_MRM_STATE, VAPI_T_U8, VAPI_Q_REALTIME, 0, 1000},
	{VAPI_P_LIGHTS_TURN_RIGHT_ISLIT, VAPI_T_BOOL, VAPI_Q_DATA, 0, 2000},
	{VAPI_LIGHT_BEAM_HIGH_ISON, VAPI_T_BOOL, VAPI_Q_DATA, 1, 2000},
	{VAPI_LIGHT_BEAM_LOW_ISON, VAPI_T_BOOL, VAPI_Q_DATA, 0, 2000},
	{VAPI_LIGHT_RUNNING_ISON, VAPI_T_BOOL, VAPI_Q_DATA, 0, 2000},
	{VAPI_LIGHT_PARKING_ISON, VAPI_T_BOOL, VAPI_Q_DATA, 0, 2000},
	{VAPI_P_LIGHT_AUTOMATEDDRIVING_ISON, VAPI_T_BOOL, VAPI_Q_DATA, 0, 2000},
	{VAPI_P_CABIN_STICK_X, VAPI_T_U16, VAPI_Q_INTERACTIVE, 0, 500},
	{VAPI_P_CABIN_STICK_Y, VAPI_T_U16, VAPI_Q_INTERACTIVE, 0, 500},
	{VAPI_ADAS_OBST_REAR_CENTER_DISTANCE, VAPI_T_F32, VAPI_Q_REALTIME, 0, 500},
	{VAPI_ADAS_OBST_REAR_CENTER_ISWARNING, VAPI_T_BOOL, VAPI_Q_REALTIME, 0, 500},
	{VAPI_ECU_STATUS, VAPI_T_JSON, VAPI_Q_BACKGROUND, 0, 3000},
	{VAPI_ECU_DISPLAY, VAPI_T_BYTES, VAPI_Q_BACKGROUND, 0, 1000},
	{VAPI_ECU_DIAG_PROXIMITY_RAW, VAPI_T_U16, VAPI_Q_BACKGROUND, 0, 500},
	{VAPI_ECU_CMD, VAPI_T_JSON, VAPI_Q_INTERACTIVE, 0, 0},
	{VAPI_ECU_CMD_ACK, VAPI_T_JSON, VAPI_Q_INTERACTIVE, 0, 0},
	{VAPI_CMD_NAME, VAPI_T_JSON, VAPI_Q_INTERACTIVE, 0, 0},
	{VAPI_ECU_ADS_STATUS, VAPI_T_JSON, VAPI_Q_INTERACTIVE, 0, 3000},
	{VAPI_ECU_ALL_CMD, VAPI_T_JSON, VAPI_Q_INTERACTIVE, 0, 0},
	{VAPI_ECU_ALL_CONFIG_DISPLAY_VIEW, VAPI_T_U8, VAPI_Q_DATA, 0, 0},
};
#define VAPI_NKEYS 33
```

## src/zone.h
```c
/* SPDX-License-Identifier: Apache-2.0 */
#pragma once
#include <stdbool.h>
#include <stddef.h>
#include <stdint.h>

/* LED0: AUTO = bus status (solid = beacons, slow blink = waiting); the rest are set over Zenoh. */
enum { ZONE_LED_AUTO, ZONE_LED_ON, ZONE_LED_OFF, ZONE_LED_BLINK };
extern volatile int zone_led_mode;

bool zone_bus_up(void);              /* PLCA active: the coordinator's beacons are heard */
uint8_t zone_plca_id(void);
void zone_ip_str(char *buf, size_t len);

/* zone_lamps.c: the VSS keys (k = key below "vehicle/") and its LED0 request (-1 none) */
void zone_lamps_on_vss(const char *k, const uint8_t *b, size_t n);
extern volatile int zone_lamp_led;

/* ptp.c: last offset to the master (ns), INT64_MIN when not locked */
int64_t zone_ptp_offset_ns(void);

/* zone_lamps.c: the vehicle as the VSS keys describe it, for the 10x10 panel; false = no car (stale) */
struct zone_vehicle {
	bool left, right, lit, hazard, brake, reverse, high_beam;
	uint8_t mrm; /* vehicle/private/mrm/state: 0 none, 1 stopping, 2 stopped */
	char gear;
	float speed_kmh, wheel_deg, accel, brake_pedal, prox_m;
	uint8_t mode;
};
bool zone_vehicle(struct zone_vehicle *v);
double zone_clock_s(void); /* the PTP clock in seconds (shared by locked zones), uptime without it */

/* zone_zenoh.c: publish one sensor value (key below "vehicle/", one little-endian scalar) if connected */
enum { ZONE_PUB_STICK_X, ZONE_PUB_STICK_Y, ZONE_PUB_PROX_RAW, ZONE_PUB_PROX_M, ZONE_PUB_PANEL, ZONE_PUB_BEAM, ZONE_PUB_VIEW, ZONE_PUB_PROX_WARN, ZONE_PUB_COUNT };
#define PROX_WARN_M 1.5f
/* main.c: the ECU's role on the Vehicle API (ecu/<role>/...): saved (`zone role`) > MAC table > Kconfig APP_ROLE >
 * the panel half / PLCA id parity (odd zone-left, even zone-right). Unique per board: two nodes with one role
 * collide on ecu/<role>/status and the console cannot address them (2026-11-02, nodes 3 and 5). */
const char *zone_role(void);
bool zone_role_valid(const char *r);
int zone_panel_half_cfg(void); /* zone_panel.c: the saved `panel half` (0 left, 1 right), -1 = none */
/* zone_zenoh.c: true once connected and the first heartbeat is out (the OTA health check); re-declare the keys */
bool zone_zenoh_healthy(void);
void zone_zenoh_rekey(void);
uint32_t zone_vss_keys(void); /* zone_lamps.c: vehicle keys received since boot */
/* main.c: the running image is confirmed (MCUboot keeps it); what the health check still waits for */
bool zone_img_confirmed(void);
const char *zone_health_str(void);
/* zone_guard.c: SMP/UDP arming (seconds left, -1 = no arming in this build), IRQ latency probe */
int zone_ota_arm(int seconds);
int zone_ota_armed_s(void);
uint32_t zone_smp_accepted(void); /* SMP datagrams let through since boot */
uint32_t zone_irq_lat_max_ns(void);
void zone_publish(int which, const void *b, size_t n);

/* main.c: RSTC.RCAUSE at boot (bit 5 watchdog, 6 software, 4 external, 0 power-on) */
extern uint8_t zone_reset_cause;

/* zone_lamps.c: the panel view every zone shows (0 lamps, 1 cluster), switched from the stick, -1 = none heard */
int zone_panel_view(void);
int zone_high_beam(void); /* the high beam as requested / as the headlamp zone reports it */
```
