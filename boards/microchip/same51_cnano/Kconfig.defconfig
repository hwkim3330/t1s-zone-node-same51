## boards/microchip/same51_cnano/Kconfig.defconfig
```kconfig
# SPDX-License-Identifier: Apache-2.0

if BOARD_SAME51_CNANO

if NETWORKING

config NET_L2_ETHERNET
	default y

endif # NETWORKING

endif # BOARD_SAME51_CNANO
```

## boards/microchip/same51_cnano/Kconfig.same51_cnano
```kconfig
# SAM E51 Curiosity Nano (EV76S68A)
# SPDX-License-Identifier: Apache-2.0

config BOARD_SAME51_CNANO
	select SOC_SAME51J20A
```
