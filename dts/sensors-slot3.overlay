/*
 * The zone node's input click in mikroBUS slot 3, whichever of the two is plugged in (both probed at boot):
 *   Thumbstick: MCP3204 12-bit ADC on the shared SPI, CS = slot 3 (cs-gpios index 2), X = ch 0, Y = ch 1
 *   Proximity:  VCNL4200 on the shared I2C at 0x51 (the click's AT24MAC402 neighbours are 0x50 / 0x58)
 */
&mikrobus_3_spi {
	thumbstick: mcp3204@2 {
		compatible = "vnd,spi-device";
		reg = <2>;
		spi-max-frequency = <1000000>;
	};
};
